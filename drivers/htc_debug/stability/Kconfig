## drivers/htc_debug/stability/Kconfig
```kconfig
# Kconfig for the HTC stability mechanism.
#

config HTC_DEBUG
	bool "HTC_DEBUG"
	default n
	---help---
	  Htc_reboot_params for the HTC stability mechanism. ???
```

## drivers/video/tegra/Kconfig
```kconfig
if ARCH_TEGRA

comment "NVIDIA Tegra Display Driver options"

config TEGRA_GRHOST
	tristate "Tegra graphics host driver"
	help
	  Driver for the Tegra graphics host hardware.

config TEGRA_GRHOST_VI
	tristate "Tegra video input host1x client driver"
	default y if TEGRA_GRHOST
	help
	  Driver for the Tegra video input hardware.
	  To compile this driver as a module, choose M here:
	  the  module will be called nvhost-vi.

config TEGRA_GRHOST_DEFAULT_TIMEOUT
	depends on TEGRA_GRHOST
	int "Default timeout for submits"
	default 10000
	help
	  Default timeout for jobs in milliseconds. Set to zero for no timeout.

config TEGRA_GRHOST_SYNC
	depends on TEGRA_GRHOST
	bool "Tegra host synchronization objects"
	default y
	select SYNC
	help
	  Add tegra host backend for the cross driver synchronization framework.
	  Allows creating sync fence file descriptors from Tegra host syncpoints.

source "drivers/video/tegra/nvmap/Kconfig"

config TEGRA_DC
	tristate "Tegra Display Contoller"
	depends on ARCH_TEGRA && TEGRA_GRHOST && I2C
	select BACKLIGHT_CLASS_DEVICE
	select FB_MODE_HELPERS
	help
	  Tegra display controller support.

config TEGRA_DC_CMU
	bool "Tegra Color Management Unit"
	default y
	help
	  Say Y here to enable Tegra color management unit.
	  Enabled by default to support color correction for panels.
	  It is used to make the representation of color match
	  accross displays.

config TEGRA_DC_WIN_H
    bool

config TEGRA_MIPI_CAL
	bool
	default y

config TEGRA_DC_SCAN_COLUMN
	bool
	default y if ARCH_TEGRA_12x_SOC

config TEGRA_DC_BLENDER_GEN2
    bool
    default y

config TEGRA_DC_BLENDER_DEPTH
    bool
    default y if ARCH_TEGRA_12x_SOC

config TEGRA_DC_BLOCK_LINEAR
    bool
    default y if ARCH_TEGRA_12x_SOC

config TEGRA_DC_INTERLACE
	bool
	default y if ARCH_TEGRA_12x_SOC

config TEGRA_DC_64BIT_SUPPORT
	bool
	help
		T12x LPAE support in dc driver

config TEGRA_DC_LOW_LATENCY_CURSOR
	bool
	default y if ARCH_TEGRA_12x_SOC

config TEGRA_DC_CLOCK_GEN2
    bool
    default y if ARCH_TEGRA_12x_SOC
    help
        T12x redefined pll usages for pll_d and pll_d2.

config TEGRA_SD_GEN2
	bool
	default y

config TEGRA_DC_TEMPORAL_DITHER
	bool
	default y

config FB_TEGRA
	tristate "Tegra Framebuffer driver"
	depends on TEGRA_DC && FB = y
	select FB_CFB_FILLRECT
	select FB_CFB_COPYAREA
	select FB_CFB_IMAGEBLIT
	default FB && !ADF
	help
	  Framebuffer device support for the Tegra display controller.

config ADF_TEGRA
	tristate "Tegra ADF driver"
	depends on TEGRA_DC && ADF && FB_TEGRA = n
	default ADF
	select ADF_FBDEV
	select ADF_MEMBLOCK
	select VIDEOBUF2_DMA_CONTIG
	help
	  ADF device support for the Tegra display controller.

config ADF_TEGRA_FBDEV
	bool "Tegra ADF fbdev support"
	depends on ADF_TEGRA
	help
	  Enables fbdev compatibility in the ADF Tegra driver.

config TEGRA_DC_EXTENSIONS
	bool "Tegra Display Controller Extensions"
	depends on TEGRA_DC && ADF_TEGRA = n
	default y
	help
	  This exposes support for extended capabilities of the Tegra display
	  controller to userspace drivers.

config TEGRA_DSI
	bool "Enable DSI panel."
	help
	  Say Y here to enable the DSI panel.

config TEGRA_DSI2EDP_TC358767
	bool "Enable DSI2EDP TC358767 bridge."
	help
	  Say Y here to enable the DSI2EDP TOSHIBA 358767 adapter.

config TEGRA_DSI2EDP_SN65DSI86
	bool "Enable DSI2EDP SN65DSI86 bridge."
	help
	  Say Y here to enable the DSI2EDP TI SN65DSI86 adapter.

config TEGRA_DP
	bool "Enable eDP panel."
	default  n
	help
	  Say Y here to enable eDP panel.

config TEGRA_LVDS
	bool "Enable LVDS panel."
	default  n
	help
	  Say Y here to enable LVDS panel.

config TEGRA_NVSR
	bool "Enable NVSR support."
	default  n
	help
	   Say Y here to enable NVSR support.

config NVMAP_CONVERT_CARVEOUT_TO_IOVMM
	bool "Convert carveout to IOVMM"
	depends on TEGRA_NVMAP && IOMMU_API
	default y
	help
	  Say Y here to force to convert carveout memory requests to
	  I/O virtual memory requests.

config TEGRA_NVHDCP
	bool "Support NVHDCP content protection on HDMI"
	help
	  Say Y here to support NVHDCP upstream and downstream protocols, this
	  requires a correctly fused chip to negotiate keys.

config TEGRA_HDMI_74MHZ_LIMIT
	bool "Support only up to 74.25 MHz HDMI pixel frequency"
	help
	  Say Y here to make kernel report only low bandwidth modes.
	  Useful only for boards which can't deliver 148.50 MHz.

endif

config TEGRA_CAMERA
	bool "Enable support for tegra camera/isp hardware"
	depends on ARCH_TEGRA
	default y
	help
	  Enables support for the Tegra camera interface

	  If unsure, say Y
```
