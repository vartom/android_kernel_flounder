/dts-v1/;

#include "tegra132-flounder-generic.dtsi"

/ {
	compatible = "google,flounder64", "nvidia,tegra132", "nvidia,tn8";
	nvidia,dtsfilename = __FILE__;
	hw-revision = "xc";

	bcmdhd_wlan {
		nv_path = "/system/etc/wifi/bcmdhd.cal";
	};
};

